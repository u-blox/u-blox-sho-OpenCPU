## BMD-360-EVAL/zephyr_evk_bsp/ubx_bmd360eval_nrf52811/Kconfig.defconfig
```kconfig
# Kconfig - BMD-360-EVAL board configuration
#
# Copyright (c) 2020 u-blox AG
#
# SPDX-License-Identifier: Apache-2.0

if BOARD_UBX_BMD360EVAL_NRF52811

config BOARD
	default "ubx_bmd360eval_nrf52811"

if USB

config USB_NRFX
	default y

config USB_DEVICE_STACK
	default y

endif # USB

config BT_CTLR
	default BT

endif # BOARD_UBX_BMD360EVAL_NRF52811
```

## EVK-NINA-B3/zephyr_evk_bsp/ubx_evkninab3_nrf52840/Kconfig.defconfig
```kconfig
# Kconfig - EVK-NINA-B3 board configuration
#
# Copyright (c) 2020 u-blox AG
#
# SPDX-License-Identifier: Apache-2.0

if UBX_BOARD_EVKNINAB3_NRF52840

config BOARD
	default "ubx_evkninab3_nrf52840"

if USB

config USB_NRFX
	default y

config USB_DEVICE_STACK
	default y

endif # USB

config IEEE802154_NRF5
	default y
	depends on IEEE802154

config BT_CTLR
	default BT

endif # UBX_BOARD_EVKNINAB3_NRF52840
```

## EVK-NINA-B4/zephyr_evk_bsp/ubx_evkninab4_nrf52833/Kconfig
```kconfig
# u-blox EVK-NINA-B4 board configuration
#
# Copyright (c) 2020 u-blox AG
# SPDX-License-Identifier: Apache-2.0

config BOARD_ENABLE_DCDC
	bool "Enable DCDC mode"
	select SOC_DCDC_NRF52X
	default y
	depends on BOARD_UBX_EVKNINAB4_NRF52833
```

## NORA-W1-OutputPower/main/Kconfig.projbuild
```kconfig
menu "u-blox RF calibration Example Configuration"
config EXAMPLE_WIFI_SSID
    string "WiFi SSID"
    default "myssid"
    help
	SSID (network name) for the example to connect to.

config EXAMPLE_WIFI_PASSWORD
    string "WiFi Password"
    default "mypassword"
    help
	WiFi password (WPA or WPA2) for the example to use.

config EXAMPLE_MAXIMUM_RETRY
    int "WiFi connection attempts"
    default 5
    help
    WiFi connection maximum retry
endmenu
```

## zephyr/boards/arm/ubx_bmd300eval_nrf52832/Kconfig.board
```kconfig
# Kconfig - BMD-300-EVAL board configuration
#
# Copyright (c) 2020 u-blox AG
#
# SPDX-License-Identifier: Apache-2.0

config  BOARD_UBX_BMD300EVAL_NRF52832
	bool "u-blox BMD-300-EVAL"
	depends on SOC_NRF52832_QFAA
```

## zephyr/boards/arm/ubx_bmd300eval_nrf52832/Kconfig.defconfig
```kconfig
# Kconfig - BMD-300-EVAL board configuration
#
# Copyright (c) 2020 u-blox AG
#
# SPDX-License-Identifier: Apache-2.0

if BOARD_UBX_BMD300EVAL_NRF52832

config BOARD
	default "ubx_bmd300eval_nrf52832"

config BT_CTLR
	default BT

endif # BOARD_UBX_BMD300EVAL_NRF52832
```

## zephyr/boards/arm/ubx_bmd330eval_nrf52810/Kconfig.defconfig
```kconfig
# Kconfig - BMD-330-EVAL board configuration
#
# Copyright (c) 2020 u-blox AG
#
# SPDX-License-Identifier: Apache-2.0

if BOARD_UBX_BMD330EVAL_NRF52810

config BOARD
	default "ubx_bmd330eval_nrf52810"

# Bluetooth not enabled by default on BMD-330 due to RAM limitations when
# running the default set of kernel tests.
# Enable this on your prj.conf to include Bluetooth support
# config BT_CTLR
# 	default BT

endif # BOARD_UBX_BMD330EVAL_NRF52832
```

## zephyr/boards/arm/ubx_bmd345eval_nrf52840/Kconfig.board
```kconfig
# Kconfig - BMD-345-EVAL board configuration
#
# Copyright (c) 2020 u-blox AG
#
# SPDX-License-Identifier: Apache-2.0

config  BOARD_UBX_BMD345EVAL_NRF52840
	bool "u-blox BMD-345-EVAL"
	depends on SOC_NRF52840_QIAA
```

## zephyr/boards/arm/ubx_evkannab1_nrf52832/Kconfig.defconfig
```kconfig
# ANNA-B1 EVK board configuration
#
# Copyright (c) 2020 u-blox AG
# SPDX-License-Identifier: Apache-2.0

if BOARD_UBX_EVKANNAB1_NRF52832

config BOARD
	default "ubx_evkannab1_nrf52832"

config BT_CTLR
	default BT

endif # BOARD_UBX_EVKANNAB1_NRF52832
```

## zephyr/boards/arm/ubx_evkannab4_nrf52833/Kconfig
```kconfig
# ANNA-B4 EVK board configuration
#
# Copyright (c) 2023 u-blox AG
# SPDX-License-Identifier: Apache-2.0

config BOARD_ENABLE_DCDC
	bool "DCDC mode"
	select SOC_DCDC_NRF52X
	default y
	depends on BOARD_UBX_EVKANNAB4_NRF52833
```

## zephyr/boards/arm/ubx_mininorab10_nrf5340/Kconfig.board
```kconfig
# u-blox MINI-NORA-B10 board configuration

# Copyright (c) 2021 u-blox AG
# SPDX-License-Identifier: Apache-2.0

if SOC_NRF5340_CPUAPP_QKAA

config BOARD_UBX_MININORAB10_NRF5340_CPUAPP
	bool "MINI-NORA-B10 nRF5340 Application MCU"

config BOARD_UBX_MININORAB10_NRF5340_CPUAPPNS
	bool "MINI-NORA-B10 nRF5340 Application MCU non-secure"

endif # SOC_NRF5340_CPUAPP_QKAA

config BOARD_UBX_MININORAB10_NRF5340_CPUNET
	bool "MINI-NORA-B10 NRF5340 Network MCU"
	depends on SOC_NRF5340_CPUNET_QKAA
```

## zephyr/boards/arm/ubx_mininorab12_nrf5340/Kconfig.board
```kconfig
# u-blox MINI-NORA-B12 board configuration

# Copyright (c) 2023 u-blox AG
# SPDX-License-Identifier: Apache-2.0

if SOC_NRF5340_CPUAPP_QKAA

config BOARD_UBX_MININORAB12_NRF5340_CPUAPP
	bool "u-blox MINI-NORA-B12 nRF5340 Application MCU"

config BOARD_UBX_MININORAB12_NRF5340_CPUAPP_NS
	bool "u-blox MINI-NORA-B12 nRF5340 Application MCU non-secure"

endif # SOC_NRF5340_CPUAPP_QKAA

config BOARD_UBX_MININORAB12_NRF5340_CPUNET
	bool "u-blox MINI-NORA-B12 nRF5340 Network MCU"
	depends on SOC_NRF5340_CPUNET_QKAA
```

## zephyr/boards/arm/ubx_r41zeval_kw41z/Kconfig.board
```kconfig
# R41Z-EVAL board
# 
#  Copyright (c) 2020 u-blox AG
# 
# SPDX-License-Identifier: Apache-2.0

config BOARD_UBX_R41ZEVAL_KW41Z
	bool "u-blox R41Z-EVAL"
	depends on SOC_SERIES_KINETIS_KWX
	select SOC_PART_NUMBER_MKW41Z512VHT4
```

## zephyr/boards/arm/ubx_xplriot1_nrf5340/Kconfig.board
```kconfig
# u-blox XPLR-IOT-1 board configuration

# Copyright (c) 2022 u-blox AG
# SPDX-License-Identifier: Apache-2.0

if SOC_NRF5340_CPUAPP_QKAA

config BOARD_UBX_XPLRIOT1_NRF5340_CPUAPP
	bool "XPLR-IOT-1 nRF5340 Application MCU"

config BOARD_UBX_XPLRIOT1_NRF5340_CPUAPPNS
	bool "XPLR-IOT-1 nRF5340 Application MCU non-secure"

endif # SOC_NRF5340_CPUAPP_QKAA

config BOARD_UBX_XPLRIOT1_NRF5340_CPUNET
	bool "XPLR-IOT-1 NRF5340 Network MCU"
	depends on SOC_NRF5340_CPUNET_QKAA
```

## zephyr/boards/arm/ubx_xplriot1_nrf5340/ubx_xplriot1_nrf5340_cpuapp_defconfig
```kconfig
# u-blox XPLR-IOT-1 board configuration

# Copyright (c) 2022 u-blox AG
# SPDX-License-Identifier: Apache-2.0

CONFIG_SOC_SERIES_NRF53X=y
CONFIG_SOC_NRF5340_CPUAPP_QKAA=y
CONFIG_BOARD_UBX_XPLRIOT1_NRF5340_CPUAPP=y

# Enable MPU
CONFIG_ARM_MPU=y

# Enable hardware stack protection
CONFIG_HW_STACK_PROTECTION=y

# Enable TrustZone-M
CONFIG_ARM_TRUSTZONE_M=y

# enable GPIO
CONFIG_GPIO=y

# Enable uart driver
CONFIG_SERIAL=y

# enable console
CONFIG_CONSOLE=y
CONFIG_UART_CONSOLE=y

# turn of LED inversion
CONFIG_DK_LIBRARY_INVERT_LEDS=n

# Default sensor configuration
CONFIG_SENSOR=y
CONFIG_I2C=y
CONFIG_BME280=y
CONFIG_ADXL345=y
CONFIG_LIS3MDL=y
CONFIG_LIS3MDL_TRIGGER_NONE=y
CONFIG_FXAS21002=y
CONFIG_LIS2DH=y
CONFIG_LIS2DH_TRIGGER_NONE=y
CONFIG_BQ274XX=y
```

## zephyr/boards/u-blox/ubx_evkannab4/Kconfig.defconfig
```kconfig
# EVK-NINA-B4 board configuration
#
# Copyright (c) 2023 u-blox AG
# SPDX-License-Identifier: Apache-2.0

if BOARD_UBX_EVKANNAB4

config BT_CTLR
	default BT

endif # BOARD_UBX_EVKANNAB4
```

## zephyr/boards/u-blox/ubx_evkannab4/Kconfig.ubx_evkannab4
```kconfig
# ANNA-B4 EVK board configuration
#
# Copyright (c) 2023 u-blox AG
# SPDX-License-Identifier: Apache-2.0

config BOARD_UBX_EVKANNAB4
	select SOC_NRF52833_QIAA
```

## zephyr/boards/u-blox/ubx_evknorab10/board.yml
```yaml
board:
  name: ubx_evknorab10
  full_name: EVK-NORA-B10
  vendor: u-blox
  socs:
  - name: 'nrf5340'
    variants:
    - name: 'ns'
      cpucluster: 'cpuapp'
```

## zephyr/boards/u-blox/ubx_evknorab12/board.yml
```yaml
board:
  name: ubx_evknorab12
  full_name: EVK-NORA-B12
  vendor: u-blox
  socs:
  - name: 'nrf5340'
    variants:
    - name: 'ns'
      cpucluster: 'cpuapp'
```

## zephyr/boards/u-blox/ubx_evknorab12/ubx_evknorab12_nrf5340_cpunet_defconfig
```kconfig
# SPDX-License-Identifier: Apache-2.0

# Enable MPU
CONFIG_ARM_MPU=y

# enable GPIO
CONFIG_GPIO=y

# Enable uart driver
CONFIG_SERIAL=y

# enable console
CONFIG_CONSOLE=y
CONFIG_UART_CONSOLE=y

# enable NORA-B12 fem
CONFIG_MPSL=y
CONFIG_MPSL_FEM=y
CONFIG_MPSL_FEM_SIMPLE_GPIO=y
```

## zephyr/boards/u-blox/ubx_evknorab2/Kconfig.defconfig
```kconfig
# Copyright (c) 2024 u-blox AG
# SPDX-License-Identifier: Apache-2.0

config HW_STACK_PROTECTION
	default ARCH_HAS_STACK_PROTECTION
if BOARD_UBX_EVKNORAB2_NRF54L15_CPUAPP

config ROM_START_OFFSET
	default 0 if PARTITION_MANAGER_ENABLED
	default 0x800 if BOOTLOADER_MCUBOOT

endif # BOARD_UBX_EVKNORAB2_CPUAPP

if BOARD_UBX_EVKNORAB2_NRF54L15_CPUAPP_NS

config BOARD_UBX_EVKNORAB2
	select USE_DT_CODE_PARTITION

config BT_CTLR
	default BT

# By default, if we build for a Non-Secure version of the board,
# enable building with TF-M as the Secure Execution Environment.
config BUILD_WITH_TFM
	default y

endif #BOARD_UBX_EVKNORAB2_NRF54L15_CPUAPP_NS
```

## zephyr/boards/u-blox/ubx_evknorab2/board.yml
```yaml
board:
  name: ubx_evknorab2
  vendor: u-blox
  socs:
  - name: nrf54l15
    variants:
    - name: xip
      cpucluster: cpuflpr
    - name: ns
      cpucluster: cpuapp
```
