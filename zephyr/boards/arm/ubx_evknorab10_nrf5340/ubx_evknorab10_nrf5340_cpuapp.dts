/*
 * u-blox EVK-NORA-B10 board configuration
 *
 * Copyright (c) 2023 u-blox AG
 * SPDX-License-Identifier: Apache-2.0
 */

/dts-v1/;
#include <nordic/nrf5340_cpuapp_qkaa.dtsi>
#include "ubx_evknorab10_cpuapp_common.dtsi"

/ {
	model = "u-blox EVK-NORA-B10 NRF5340 Application";
	compatible = "nordic,ubx-evknorab10-nrf5340-cpuapp";

	chosen {
		zephyr,sram = &sram0_image;
		zephyr,flash = &flash0;
		zephyr,code-partition = &slot0_partition;
		zephyr,sram-secure-partition = &sram0_s;
		zephyr,sram-non-secure-partition = &sram0_ns;
	};
};
