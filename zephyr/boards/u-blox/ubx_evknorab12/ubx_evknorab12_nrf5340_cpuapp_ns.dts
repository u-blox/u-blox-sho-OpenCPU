/*
 * u-blox EVK-NORA-B12 board configuration
 *
 * Copyright (c) 2023 u-blox AG
 * SPDX-License-Identifier: Apache-2.0
 */

/dts-v1/;
#include <nordic/nrf5340_cpuappns_qkaa.dtsi>
#include "ubx_evknorab12_cpuapp_common.dtsi"

/ {
	model = "u-blox EVK-NORA-B12 NRF5340 Application";
	compatible = "nordic,ubx-evknorab12-nrf5340-cpuapp";

	chosen {
		zephyr,sram = &sram0_ns_app;
		zephyr,flash = &flash0;
		zephyr,code-partition = &slot0_ns_partition;
	};
};
